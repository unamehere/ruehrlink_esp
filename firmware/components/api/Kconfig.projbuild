## firmware/components/api/Kconfig.projbuild
```kconfig
menu "Freikoch: App-API"

config FK_PAIR_BUTTON_GPIO
    int "GPIO der Taste zum Koppeln (aktiv low)"
    default 0
    help
        DevKit: BOOT-Taste = GPIO0.

endmenu
```

## firmware/components/diag/Kconfig.projbuild
```kconfig
menu "Ruehrlink: Diagnose"

config RL_DIAG_LOG_SIZE
    int "Groesse des Log-Puffers im RAM (Byte)"
    range 2048 32768
    default 8192
    help
        Die letzten Log-Ausgaben der Firmware fuer "Problem melden" in der App
        (GET /api/v1/diag). Liegt fest im internen RAM; Zugangsdaten werden vor
        dem Speichern maskiert.

endmenu
```

## firmware/components/led/Kconfig.projbuild
```kconfig
menu "Ruehrlink: Status-LED und Schuesselbeleuchtung"

config RL_LED_R_GPIO
    int "Status-LED: GPIO rot"
    default 22
    help
        Rot und gruen je ueber einen 2N7002 an 5 V, aktiv high, gedimmt per LEDC. Rot + gruen = gelb.

config RL_LED_G_GPIO
    int "Status-LED: GPIO gruen"
    default 23

config RL_LED_G_SCALE
    int "Status-LED: Helligkeit gruen in Prozent von rot"
    range 1 100
    default 15
    help
        Platine Rev. 3: R6 (330 Ohm) ist fuer die gruene LED zu klein, sie ist viel heller als rot.
        Bis zur naechsten Revision wird gruen hier gedrosselt.

config RL_LED_CONNECTED_PCT
    int "Daueranzeige Maschine verbunden: Helligkeit gruen in Prozent (0 = aus)"
    range 0 100
    default 10
    help
        Zwischen den kurzen Signalen leuchtet gruen gedimmt, solange die Maschine verbunden ist.
        Prozent der normalen Signal-Helligkeit; 0 schaltet die Daueranzeige ab.

config RL_STRIP_DATA_GPIO
    int "Schuesselbeleuchtung: Daten-GPIO (WS2812/SK6812)"
    default 0
    help
        Ruehrlink-Platine: IO0 -> 2N7002 -> J3 Pin 2. Der Pegelwandler invertiert (RL_STRIP_INVERT).

config RL_STRIP_INVERT
    bool "Schuesselbeleuchtung: Datensignal invertieren"
    default y
    help
        Platine Rev. 3: Datenleitung ueber einen 2N7002 mit Pull-up auf 5 V - invertiert.

config RL_STRIP_EN_GPIO
    int "Schuesselbeleuchtung: GPIO 5-V-Schalter (-1 = keiner)"
    default 1
    help
        Ruehrlink-Platine: IO1 schaltet ueber Q5/Q4 die 5 V an der Buchse J3 (aktiv high).

config RL_STRIP_LEDS
    int "Schuesselbeleuchtung: Anzahl LEDs"
    range 1 300
    default 30

endmenu
```

## firmware/components/storage/Kconfig.projbuild
```kconfig
menu "Ruehrlink: Speicher"

config RL_STORAGE_USE_SD
    bool "microSD-Karte ueber SPI (SDSPI)"
    default y
    help
        Rezepte, Fotos und Programme liegen auf einer microSD-Karte (FAT32), angeschlossen
        ueber SPI. Steckt keine Karte oder ist sie nicht lesbar, greift der Rueckfall unten.

config RL_STORAGE_FLASH_FALLBACK
    bool "Rueckfall: SD-Emulation im internen Flash"
    default y
    help
        Ohne (lesbare) Karte haengt die Bruecke stattdessen ein FAT mit Wear Leveling auf
        der Flash-Partition "storage" ein (Entwicklung, ca. 10 MB). Braucht die Partition
        "storage" in partitions.csv.

if RL_STORAGE_USE_SD

config RL_SD_PIN_MISO
    int "SD: MISO (Karte DAT0)"
    default 18
    help
        Ruehrlink-Platine: IO18.

config RL_SD_PIN_MOSI
    int "SD: MOSI (Karte CMD)"
    default 20
    help
        Ruehrlink-Platine: IO20.

config RL_SD_PIN_SCK
    int "SD: SCK (Karte CLK)"
    default 19
    help
        Ruehrlink-Platine: IO19.

config RL_SD_PIN_CS
    int "SD: CS (Karte DAT3)"
    default 21
    help
        Ruehrlink-Platine: IO21.

config RL_SD_FREQ_KHZ
    int "SD: SPI-Takt in kHz"
    default 20000
    range 400 40000
    help
        20 MHz laeuft mit kurzen Leitungen sicher. Bei Lesefehlern mit fliegender
        Verdrahtung (Steckbrett) auf 10000 oder 4000 senken.

config RL_SD_FORMAT_IF_FAILED
    bool "SD: unlesbare Karte formatieren"
    default n
    help
        Aus: Eine Karte ohne FAT (z. B. exFAT bei Karten ab 64 GB) wird nicht angefasst,
        die Bruecke faellt auf den Flash zurueck. An: Karte wird ohne Rueckfrage formatiert.

endif

config RL_STORAGE_MAX_FILES
    int "Gleichzeitig offene Dateien"
    default 2
    range 1 8
    help
        Jede offene Datei kostet internen RAM (Dateiobjekt + Sektorpuffer). Die Bruecke
        oeffnet hoechstens zwei gleichzeitig (eine Antwort streamen, eine schreiben).

endmenu
```

## firmware/src/Kconfig.projbuild
```kconfig
menu "Ruehrlink: Allgemein"

config RL_DEVELOPER_MODE
    bool "Entwicklermodus"
    default n
    help
        Nur fuer Entwickler-Builds, nie in ausgelieferter Firmware:
        - Entwickler-Zugangsdaten aus dem NVS (tools/dev_nvs.py) werden uebernommen
        - Diagnose-Ausgaben auf der seriellen Konsole (z. B. fremdes Zertifikat
          des Einrichtungs-Servers der Maschine)

config RL_BOOT_GPIO
    int "GPIO der BOOT-Taste"
    default 9
    help
        Ruehrlink-Platine: IO9 (SW1, Pull-up R4).

config RL_RAM_LOG
    bool "RAM-Verbrauch alle 10 s ausgeben"
    depends on RL_DEVELOPER_MODE
    default n
    help
        Gibt freien internen RAM, den Tiefststand seit dem Start und den groessten
        freien Block aus und meldet jede fehlgeschlagene Speicheranforderung
        (ESP32-C6 ohne PSRAM: RAM ist knapp).

config RL_SPEED_TEST
    bool "Testmodus Stufen (rohe Werte 0-15 statt benannter Stufen)"
    depends on RL_DEVELOPER_MODE
    default n

endmenu
```
